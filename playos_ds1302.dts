playos_ds1302@0 {
    compatible = "playos,ds1302";
    ce-gpio = <&gpio GPIOH_8 GPIO_ACTIVE_HIGH>;
    clk-gpio = <&gpio GPIOH_9 GPIO_ACTIVE_HIGH>;
    data-gpio = <&gpio_ao GPIOAO_6 GPIO_ACTIVE_HIGH>;
    burst-mode;

    status = "okay";
};
